OUTPUT_FORMAT("binary")

ENTRY(stub32)

SECTIONS {
    . = 0x8000;

    .text : {
        *(.text)
    }

    .data : {
        *(.data)
    }

    .rodata : {
        *(.rodata)
    }

    .bss : {
        *(.bss)
    }
}

